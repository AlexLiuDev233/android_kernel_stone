## drivers/hmapp/Kconfig
```kconfig
menu "Hide My Applist++"

config HMA_PP
	tristate "Hide My Applist"
	default y
	help
	  Fix /storage/emulated/0/Android/data applist leak

config HMA_PP_KSU
	bool "HMA++ with KernelSU denylist"
	depends on KSU && HMA_PP
	default y
	help
	  Enable KernelSU App Profile Compatibility
endmenu
```

## drivers/rcinjector/Kconfig
```kconfig
menu "RC Injector"

config RC_INJECTOR
	  tristate "Android RC Injector"
	  default y
	  help
		Enable kernel-level atrace.rc injector standalone on Android System.

endmenu
```

## drivers/rekernel/Kconfig
```kconfig
menu "Re:Kernel"

config REK
	tristate "Re:Kernel support"
	default y
	help
	  Make tombstone users get a better experience.

config REK_DEBUG
	bool "Re:Kernel debug mode"
	default n
	help
	  Enable Re:Kernel debug logging output.

endmenu
```

## drivers/staging/mi-perf/low_free_memory_kill/Kconfig
```kconfig
config LOW_FREE_MEMORY_KILL
	tristate "kill process in low free memory"
	depends on KSU
	default n
```
